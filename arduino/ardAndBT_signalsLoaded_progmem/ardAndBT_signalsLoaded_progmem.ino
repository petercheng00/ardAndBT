#include <avr/pgmspace.h>

int IRledPin =  5;
int signalLedPin = 6;

String currentReading = "";

prog_uint16_t power[] PROGMEM = {
  25300,2380,560,1200,580,600,560,1200,580,600,560,1200,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580,600};
prog_uint16_t channelUp[] PROGMEM = {
  25300,2400,560,620,560,600,560,620,560,620,560,1200,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560,620};
prog_uint16_t channelDown[] PROGMEM = {
  25300,2380,560,1200,560,620,560,620,560,620,560,1200,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560,600};
prog_uint16_t volumeUp[] PROGMEM = {
  25300,2380,560,620,560,1220,560,600,560,620,560,1220,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580,600};
prog_uint16_t volumeDown[] PROGMEM = {
  25300,2380,580,1200,560,1200,560,620,560,620,560,1200,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560,620};
prog_uint16_t one[] PROGMEM = {
  25300,2380,600,580,600,580,600,580,580,600,580,600,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560,620};
prog_uint16_t two[] PROGMEM = {
  25300,2380,580,1200,560,600,580,600,560,620,560,620,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580,600};
prog_uint16_t three[] PROGMEM = {
  25300,2380,580,600,560,1200,580,600,580,600,560,620,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560,620};
prog_uint16_t four[] PROGMEM = {
  25300,2380,560,1200,560,1200,560,620,560,620,560,620,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580,600};
prog_uint16_t five[] PROGMEM = {
  25300,2380,560,600,580,620,560,1200,560,620,560,620,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580,600};
prog_uint16_t six[] PROGMEM = {
  25300,2400,540,1200,560,620,560,1200,580,600,580,620,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560,600};
prog_uint16_t seven[] PROGMEM = {
  25300,2400,560,600,560,1220,560,1200,560,620,560,620,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560,620};
prog_uint16_t eight[] PROGMEM = {
  25300,2380,580,1200,560,1200,560,1200,560,620,560,620,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560,600};
prog_uint16_t nine[] PROGMEM = {
  25300,2380,580,600,580,600,560,620,560,1200,580,600,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580,600};
prog_uint16_t zero[] PROGMEM = {
  25300 ,2380,560,1200,560,620,560,600,580,1200,560,620,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580,600};

HardwareSerial bluetooth = HardwareSerial();

void setup() {
  Serial.begin(9600);

  bluetooth.begin(9600);
  bluetooth.print("$$$");
  delay(100);
  bluetooth.println("U,9600,N");
  bluetooth.begin(9600);
  pinMode(IRledPin, OUTPUT);
  pinMode(signalLedPin, OUTPUT);
}

void loop() {
  // Serial.println("foo");
  if (bluetooth.available())
  {
    for(int j = 0; j < 3; j++) {
      digitalWrite(signalLedPin, HIGH);
      delay(20);
      digitalWrite(signalLedPin, LOW);
      delay(20);
    }
    currentReading= bluetooth.readStringUntil('\n');
    Serial.println(currentReading);
    String currentSignal = "";
    for(int i = 0; i < currentReading.length(); i++) {
      if(currentReading.charAt(i) != ',') {
        currentSignal.append(currentReading.charAt(i));
      } 
      else {
        processAndSendSignal(currentSignal);
        currentSignal = "";
      }
    }
    
  }
}

void processAndSendSignal(String signal) {
  if(signal.equals("P")) {
    sendSignal(power, 78);
  } 
  else if(signal.equals("CU")) {
    sendSignal(channelUp, 78);
  } 
  else if(signal.equals("CD")) {
    sendSignal(channelDown, 78);
  } 
  else if(signal.equals("VU")) {
    sendSignal(volumeUp, 104);
  } 
  else if(signal.equals("VD")) {
    Serial.println("am i here?");
    sendSignal(volumeDown, 104);
  } 
  else {
    sendChannelSignal(currentReading);
  }
}

void sendChannelSignal(String reading) {
  for(int i = 0; i < reading.length(); i++){
    char number = reading.charAt(i);
    int channelNum = number - '0';
    switch(channelNum){
    case 1:
      sendSignal(one, 78);
      break;
    case 2:
      sendSignal(two, 78);
      break;
    case 3:
      sendSignal(three, 78);
      break;
    case 4:
      sendSignal(four, 78);
      break;
    case 5:
      sendSignal(five, 78);
      break;
    case 6:
      sendSignal(six, 78);
      break;
    case 7:
      sendSignal(seven, 78);
      break;
    case 8:
      sendSignal(eight, 78);
      break;
    case 9:
      sendSignal(nine, 78);
      break;
    case 0:
      sendSignal(zero, 78);
      break;
    }
  }
}


void sendSignal(prog_uint16_t signal[], int size){
  for(int i = 0; i < size; i++) {
    unsigned int number = pgm_read_word_near(signal + i);
    if(i % 2 == 0) {
      //Serial.println("waiting for");]
      if(number > 16000) {
        delay(number/1000);
      } 
      else {
        delayMicroseconds(number+20);
      }
    } 
    else {
      //Serial.println("pulsing for");
      pulseIR(number);
    }
    //Serial.println(signal[i]);
  }
  //}
}

// This procedure sends a 38KHz pulse to the IRledPin 
// for a certain # of microseconds. We'll use this whenever we need to send codes
void pulseIR(long microsecs) {

  // we'll count down from the number of microseconds we are told to wait

  cli();  // this turns off any background interrupts

  while (microsecs > 0) {
    // 38 kHz is about 13 microseconds high and 13 microseconds low
    digitalWrite(IRledPin, HIGH);  // this takes about 3 microseconds to happen
    delayMicroseconds(14);         // hang out for 10 microseconds
    digitalWrite(IRledPin, LOW);   // this also takes about 3 microseconds
    delayMicroseconds(15);         // hang out for 10 microseconds

    // so 26 microseconds altogether
    microsecs -= 26;
  }

  sei();  // this turns them back on
}

